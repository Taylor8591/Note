
/dts-v1/;

#include "zynq-7000.dtsi"

/ {
    model = "Simple Zynq Board";
    compatible = "simple,board", "xlnx,zynq-7000";

    
    memory@0 {
        device_type = "memory";
        reg = <0x0 0x40000000>;
    };

    
    chosen {
        bootargs = "console=ttyPS0,115200 root=/dev/mmcblk0p2 rootwait";
        stdout-path = "serial0:115200n8";
    };
};


&uart0 {
    status = "okay";
};